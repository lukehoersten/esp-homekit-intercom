## main/Kconfig.projbuild
```kconfig
menu "HomeKit Intercom Configuration"

    config HOMEKIT_USE_HARDCODED_SETUP_CODE
        bool "Use hard-coded setup code"
        default y
        help
            HomeKit does not recommend having the setup code programmed in the accessory as is.
            Instead, it expects setup info (salt-verifier pair) generated for the given setup code.
            Use this option only for testing purposes. For production, the setup info should be
            used.

    config HOMEKIT_SETUP_CODE
        string "HomeKit Setup Code"
        default "111-22-333"
        depends on HOMEKIT_USE_HARDCODED_SETUP_CODE
        help
            Setup code to be used for HomeKit pairing, if hard-coded setup code is enabled.

    config HOMEKIT_SETUP_ID
        string "HomeKit Setup Id"
        default "ES32"
        depends on HOMEKIT_USE_HARDCODED_SETUP_CODE
        help
            Setup id to be used for HomeKit pairing, if hard-coded setup code is enabled.

    config HOMEKIT_INTERCOM_LOCK_TIMEOUT
        int "HomeKit Intercom Millisecond Timeout"
        default 10000
        help
            Milliseconds before locking intercom

endmenu
```
